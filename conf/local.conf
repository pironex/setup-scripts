## conf/local.conf
```bitbake
# CONF_VERSION is increased each time build/conf/ changes incompatibly
CONF_VERSION = "1"

INHERIT += "rm_work"

# Which files do we want to parse:
BBMASK = ""

# What kind of images do we want?
IMAGE_FSTYPES_append = " tar.xz ubi jffs2 ext3 "

# Make use of SMP:
#   PARALLEL_MAKE specifies how many concurrent compiler threads are spawned per bitbake process
#   BB_NUMBER_THREADS specifies how many concurrent bitbake tasks will be run
PARALLEL_MAKE     = "-j4"
BB_NUMBER_THREADS = "3"

DISTRO = "angstrom-v2013.06"
# Set DEPLOY_DIR outside of TMPDIR

DEPLOY_DIR = "${TMPDIR}/../../deploy/${TCLIBC}"
# Don't generate the mirror tarball for SCM repos, the snapshot is enough
BB_GENERATE_MIRROR_TARBALLS = "0"

#SDKMACHINE = "x86-64"
SDKMACHINE = "i686"

# Disable build time patch resolution. This would lauch a devshell
# and wait for manual intervention. We disable it.
PATCHRESOLVE = "noop"

#
# Shared-state files from other locations
#
# Shared state files are prebuilt cache data objects which can 
# used to accelerate build time. This variable can be used to configure the system
# to search other mirror locations for these objects before it builds the data itself.
#
# This can be a filesystem directory, or a remote url such as http or ftp. These
# would contain the sstate-cache results from previous builds (possibly from other 
# machines). This variable works like fetcher MIRRORS/PREMIRRORS and points to the 
# cache locations to check for the shared objects.
#SSTATE_MIRRORS ?= "\
#file://.* http://someserver.tld/share/sstate/ \n \
#file://.* file:///some/local/dir/sstate/"

#SSTATE_MIRRORS ?= "\
#file://.* http://dominion.thruhere.net/angstrom/sstate-mirror/ \n "

# enable PR service on build machine itself
# its good for a case when this is the only builder
# generating the feeds
#
PRSERV_HOST = "localhost:0"

PREFERRED_PROVIDER_eglibc = "eglibc"
PREFERRED_VERSION_libnl = "1:3.2.21"
PREFERRED_VERSION_hostap-daemon = "1.0"
# arago-extras has some strange version
PREFERRED_VERSION_wpa-supplicant = "2.0"
PREFERRED_PROVIDER_wpa-supplicant = "wpa-supplicant"
PREFERRED_PROVIDER_wpa-supplicant-cli = "wpa-supplicant"
PREFERRED_PROVIDER_wpa-supplicant-passphrase = "wpa-supplicant"
# arago-extras has 4.98 which overrides this
PREFERRED_VERSION_bluez4 = "4.101"
PREFERRED_PROVIDER_qwt = "qwt-e"
PREFERRED_PROVIDER_libqwt-dev = "qwt-e"
PREFERRED_PROVIDER_binutils-cross-canadian-arm = "binutils-cross-canadian-arm"
PREFERRED_PROVIDER_gcc-cross-canadian-arm = "gcc-cross-canadian-arm"
#PREFERRED_VERSION_connman = "1.12"
```
